/**
 * @cliArgs --board "/ti/boards/MSP_EXP432P401R" --product "simplelink_msp432p4_sdk@3.40.01.02" --product "sail@1.50.00.00"
 * @versions {"data":"2020090214","timestamp":"2020090214","tool":"1.6.0+1543","templates":"2020090214"}
 */
const BOOSTXL_SENSORS = scripting.addHardware("/ti/boards/boosterpacks/BOOSTXL-SENSORS");

/**
 * Import the modules used in this configuration.
 */
const Display  = scripting.addModule("/ti/display/Display");
const Display1 = Display.addInstance();
const GPIO     = scripting.addModule("/ti/drivers/GPIO");
const GPIO1    = GPIO.addInstance();
const I2C      = scripting.addModule("/ti/drivers/I2C");
const I2C1     = I2C.addInstance();
const RTOS     = scripting.addModule("/ti/drivers/RTOS");
const SPI      = scripting.addModule("/ti/drivers/SPI", {}, false);
const SPI1     = SPI.addInstance();

/**
 * Write custom configuration values to the imported modules.
 */
Display1.$name      = "CONFIG_Display_0";
Display1.$hardware  = system.deviceData.board.components.XDS110UART;
Display1.uart.$name = "CONFIG_UART_0";

GPIO1.$name     = "CONFIG_GPIO_BMI160_INT1";
GPIO1.$hardware = BOOSTXL_SENSORS.components.BMI160_BMM150.subComponents.INT1;
GPIO1.pull      = "Pull Down";

I2C1.$name     = "CONFIG_I2C_BMI";
I2C1.$hardware = BOOSTXL_SENSORS.components.SENSORS_I2C;

const Power                   = scripting.addModule("/ti/drivers/Power", {}, false);
Power.performanceLevel3.$name = "ti_drivers_power_PowerMSP432PerfLevels0";
Power.performanceLevel2.$name = "ti_drivers_power_PowerMSP432PerfLevels1";
Power.performanceLevel1.$name = "ti_drivers_power_PowerMSP432PerfLevels2";
Power.performanceLevel0.$name = "ti_drivers_power_PowerMSP432PerfLevels3";


SPI1.$name               = "GFG_SPI";
SPI1.mode                = "Four Pin SS Active Low";
SPI1.minDmaTransferSize  = 10000;
SPI1.spi.$assign         = "EUSCI_B3";
SPI1.spi.sclkPin.$assign = "expansion.28";
SPI1.spi.misoPin.$assign = "expansion.30";
SPI1.spi.mosiPin.$assign = "expansion.29";
SPI1.spi.ssPin.$assign   = "expansion.27";

/**
 * Pinmux solution for unlocked pins/peripherals. This ensures that minor changes to the automatic solver in a future
 * version of the tool will not impact the pinmux you originally saw.  These lines can be completely deleted in order to
 * re-solve from scratch.
 */
Display1.uart.uart.$suggestSolution          = "EUSCI_A0";
Display1.uart.uart.txPin.$suggestSolution    = "P1.3.GPIO/EUSCI_A0_UART.TXD/EUSCI_A0_SPI.SIMO";
Display1.uart.uart.rxPin.$suggestSolution    = "P1.2.GPIO/EUSCI_A0_UART.RXD/EUSCI_A0_SPI.SOMI";
GPIO1.gpioPin.$suggestSolution               = "boosterpack.5";
I2C1.i2c.$suggestSolution                    = "EUSCI_B1";
I2C1.i2c.sdaPin.$suggestSolution             = "boosterpack.10";
I2C1.i2c.sclPin.$suggestSolution             = "boosterpack.9";
RTOS.timer0.resource.$suggestSolution        = "Timer_A0";
SPI1.spi.dmaRxChannel.$suggestSolution       = "DMA_CH1";
SPI1.spi.dmaTxChannel.$suggestSolution       = "DMA_CH0";
SPI1.spi.dmaInterruptNumber.$suggestSolution = "DMA_INT0";
